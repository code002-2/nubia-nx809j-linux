## uboot/configs/qcom_nx809j_defconfig
```kconfig
CONFIG_ARM=y
CONFIG_SKIP_LOWLEVEL_INIT=y
CONFIG_POSITION_INDEPENDENT=y
CONFIG_SYS_INIT_SP_BSS_OFFSET=0x180000
CONFIG_ARCH_SNAPDRAGON=y
CONFIG_NR_DRAM_BANKS=24
CONFIG_DEFAULT_DEVICE_TREE="kaanapali-nubia-nx809j"
CONFIG_SYS_LOAD_ADDR=0xA0000000
# CONFIG_EFI_LOADER is not set
# CONFIG_BOOTMETH_EXTLINUX is not set
CONFIG_BOOTDELAY=-2
CONFIG_CONSOLE_RECORD=y
CONFIG_CONSOLE_RECORD_OUT_SIZE=0x6000
CONFIG_SYS_CBSIZE=2048
CONFIG_LOG_MAX_LEVEL=9
CONFIG_LOG_DEFAULT_LEVEL=7
# CONFIG_DISPLAY_CPUINFO is not set
CONFIG_DISPLAY_BOARDINFO_LATE=y
CONFIG_CMD_BOOTDEV=y
# CONFIG_CMD_BOOTFLOW is not set
CONFIG_CMD_MEMINFO=y
CONFIG_CMD_MEMINFO_MAP=y
# CONFIG_CMD_UNZIP is not set
CONFIG_CMD_CLK=y
CONFIG_CMD_PART=y
# CONFIG_CMD_SCSI is not set
CONFIG_CMD_PAUSE=y
CONFIG_CMD_SYSBOOT=y
CONFIG_SUPPORT_RAW_INITRD=y
CONFIG_CMD_LOG=y
CONFIG_EFI_PARTITION=y
CONFIG_OF_LIVE=y
# CONFIG_OF_UPSTREAM is not set
CONFIG_ENV_USE_DEFAULT_ENV_TEXT_FILE=y
CONFIG_ENV_DEFAULT_ENV_TEXT_FILE="board/qualcomm/nx809j.env"
# CONFIG_NET is not set
CONFIG_CLK=y
CONFIG_CLK_STUB=y
CONFIG_CLK_QCOM_KAANAPALI=y
CONFIG_IOMMU=y
CONFIG_QCOM_HYP_SMMU=y
# CONFIG_MMC is not set
CONFIG_PHY=y
CONFIG_PHY_QCOM_QMP_UFS=y
CONFIG_SCSI=y
# CONFIG_REQUIRE_SERIAL_CONSOLE is not set
CONFIG_UFS=y
CONFIG_UFS_QCOM=y
CONFIG_VIDEO=y
# CONFIG_VIDEO_FONT_8X16 is not set
CONFIG_VIDEO_FONT_16X32=y
CONFIG_SYS_WHITE_ON_BLACK=y
CONFIG_NO_FB_CLEAR=y
CONFIG_VIDEO_SIMPLE=y
CONFIG_FS_FAT=y
CONFIG_PANIC_HANG=y
```
